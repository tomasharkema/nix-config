/dts-v1/;
/plugin/;

/ {
  compatible = "brcm,bcm2835";

	fragment@0 {
		target = <&i2c_arm>;
		__overlay__ {
			ina219@43 {
				compatible = "ti,ina219";
				reg = <0x43>;
				#abracon,tc-diode = "standard";
				#3abracon,tc-resistor = <0>;
			};
		};
	};
};
